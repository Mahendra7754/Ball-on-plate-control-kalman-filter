// T32_1 Wed May 04 11:47:52 2011

 B::
 
 TOOLBAR ON
 STATUSBAR ON
 FRAMEPOS 7.7143 2.1667 165. 70.
 WINPAGE.RESET
 
 WINCLEAR
 WINPOS 0.0 0.0 47. 20. 0. 0. W001
 Register /Spotlight
 
 WINPOS 0.0 25.0 47. 15. 15. 0. W002 NORMAL "Interrupt Vector Table"
 Data.dump 0x8000000 /NoASCII
 
 WINPOS 0.0 44.917 92. 6. 15. 1. W004
 Data.dump 0x08000094 /BYTE /DIALOG
 
 WINPOS 0.14286 58.25 160. 7. 0. 0. W003 NORMAL "Messages"
 AREA
 
 WINPOS 96.143 45.0 64. 8. 15. 1. W005
 Data.dump 0x20000000 /BYTE
 
 WINPOS 51.0 0.0 109. 38. 15. 0. MainCode NORMAL "C-Source & Assemblercode"
 WINTABS 10. 10. 25. 62.
 Data.List
 
 WINPAGE.SELECT P000     
 
 ENDDO
